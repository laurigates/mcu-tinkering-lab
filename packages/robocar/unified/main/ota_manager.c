/**
 * @file ota_manager.c
 * @brief OTA update manager for the single-board unified robocar
 *
 * Polls the web-flasher's published manifest (the same JSON the Pages site
 * and ESP Web Tools consume, generated by tools/generate-flasher-manifests.sh)
 * rather than the GitHub Releases API. See issue #539: esp_ghota called the
 * wrong API host, its filename match could never hit, and monorepo
 * release-please tags do not parse as semver — none of which is fixable by
 * configuration. The manifest carries a clean per-project version and the
 * app binary's path directly, so there is nothing left to parse out of a
 * GitHub API response.
 *
 * A dedicated FreeRTOS task checks OTA_FIRST_CHECK_DELAY_MS after it starts,
 * then blocks on either the OTA_CHECK_INTERVAL_MIN periodic timeout or an
 * explicit task notification (the MQTT check-now nudge), and each time
 * performs one manifest fetch + compare + (maybe) flash cycle.
 * Per .claude/rules/freertos-task-gotchas.md, any task making an HTTPS call
 * needs at least an 8 KB stack for the TLS handshake — this task is created
 * with OTA_TASK_STACK_SIZE, already 8192 in config.h.
 */

#include "ota_manager.h"

#include <stdio.h>
#include <stdlib.h>
#include <string.h>

#include "audio_player.h"
#include "cJSON.h"
#include "config.h"
#include "esp_app_desc.h"
#include "esp_crt_bundle.h"
#include "esp_http_client.h"
#include "esp_https_ota.h"
#include "esp_log.h"
#include "esp_ota_ops.h"
#include "esp_timer.h"
#include "freertos/FreeRTOS.h"
#include "freertos/task.h"
#include "freertos/timers.h"
#include "gemini_backend.h"
#include "ota_announce.h"
#include "ota_interval.h"
#include "ota_park.h"
#include "ota_update_decision.h"
#include "ota_version_compare.h"
#include "reactive_controller.h"
#include "speech_queue.h"
#include "voice_persona.h"
#include "voice_turn.h"
#if MQTT_LOGGING_ENABLED
#include "mqtt_logger.h"
#endif

static const char *TAG = "OTA_Manager";

/** Core 1 — bursty, I/O-bound, same as camera_task/planner_task/network_task
 *  (see CLAUDE.md's Architecture section). Never Core 0: that core is
 *  reserved for the timing-sensitive motor/reactive-controller loop. */
#define OTA_TASK_CORE 1
/** manifest.json is a few hundred bytes plus its "notes" list, which
 *  tools/changelog-notes.py caps at 800 bytes so that firmware with the old
 *  2048-byte buffer still reads it whole (a cut-short manifest does not
 *  parse). Heap, not the task stack. */
#define OTA_MANIFEST_BUF_SIZE 4096
/** Facts handed to the announcement prompt: versions plus the notes. */
#define OTA_FACTS_BUF_SIZE 1024
/** How long to wait for a quiet moment (no voice turn, conversation or
 *  playback) before announcing; past it the install waits for the next check. */
#define OTA_QUIET_WAIT_MS (10U * 60U * 1000U)
/** Poll period for the quiet wait, the speech wait and the postpone window. */
#define OTA_POLL_MS 250U
/** Executor tick for the park; leases outlive two of them. */
#define OTA_PARK_TICK_MS 50U
#define OTA_PARK_LEASE_MS 200U
/** Forward nudge speed (0..255) when something is close behind. */
#define OTA_PARK_NUDGE_SPEED 120U
/** Speech is done when the player has been idle this long after playing. */
#define OTA_SPEECH_GAP_MS 1500U
#define OTA_SPEECH_WAIT_MS 60000U
/** Long enough for the Pages host + path + a project-scoped .bin filename. */
#define OTA_BIN_URL_BUF_SIZE 256
/** esp_app_get_description()->version is a fixed 32-byte field. */
#define OTA_VERSION_STR_BUF_SIZE 32
/** {"status":"refused","reason":<= 20 chars,"version":<= 31 chars} */
#define OTA_STATUS_PAYLOAD_BUF_SIZE 128

/* Set by main/CMakeLists.txt from the project CMakeLists.txt's commit lookup
 * (issue #627). The fallback keeps a build outside that path compiling; the
 * OTA decision treats it exactly like a dirty tree — no usable SHA. */
#ifndef ROBOCAR_BUILD_SHA
#define ROBOCAR_BUILD_SHA "unknown"
#endif

// OTA manager state
static TaskHandle_t s_ota_task_handle = NULL;
static bool s_ota_in_progress = false;

/* Where the pre-install sequence is (ota_manager_phase()), the version it is
 * for, and the postpone window ota_manager_postpone() writes from the console
 * task. One mutex for all three. */
static portMUX_TYPE s_flow_mux = portMUX_INITIALIZER_UNLOCKED;
static ota_phase_t s_phase = OTA_PHASE_IDLE;
static char s_pending_version[32];
static ota_window_t s_window;
static bool s_firmware_valid_confirmed = false;
static TimerHandle_t s_stability_timer = NULL;

// Forward declarations
static void ota_task(void *arg);
static void run_update_check(void);
static void start_https_ota(const char *bin_url);
static bool announce_and_park(const char *remote_version, const char *facts);
static void set_phase(ota_phase_t phase);
static esp_err_t fetch_manifest_json(char *buf, size_t buf_size, int *status_out);
static bool select_app_part_path(const cJSON *manifest, const char **path_out);
static bool resolve_relative_url(const char *base_url, const char *relative_path, char *out,
                                 size_t out_size);
static void ota_stability_timer_callback(TimerHandle_t xTimer);
static void report_refusal(ota_update_decision_t decision, const char *remote_version);

#if MQTT_LOGGING_ENABLED
static void mqtt_ota_notify_handler(const char *topic, const char *data, int data_len);
#endif

esp_err_t ota_manager_init(void)
{
    ESP_LOGI(TAG, "Initializing OTA manager");
    ESP_LOGI(TAG, "Current firmware version: %s (build %s)", ota_manager_get_version(),
             ota_manager_get_build_sha());

    BaseType_t created =
        xTaskCreatePinnedToCore(ota_task, "ota_task", OTA_TASK_STACK_SIZE, NULL, OTA_TASK_PRIORITY,
                                &s_ota_task_handle, OTA_TASK_CORE);
    if (created != pdPASS) {
        ESP_LOGE(TAG, "Failed to create OTA task");
        return ESP_FAIL;
    }

    ESP_LOGI(TAG, "OTA check task started (interval: %d min, manifest: %s)", OTA_CHECK_INTERVAL_MIN,
             OTA_MANIFEST_URL);

#if MQTT_LOGGING_ENABLED
    /* Subscribe to the OTA check-now nudge (mqtt_ota_notify_handler()). It
     * used to be ignored when it failed, and logged "Subscribed" while the
     * client did not exist yet (issue #1054). A failure loses only the nudge:
     * the periodic check and the rollback timer below still run, so it is
     * reported and initialisation carries on. */
    const esp_err_t sub_ret = mqtt_logger_subscribe(OTA_MQTT_NOTIFY_TOPIC, mqtt_ota_notify_handler);
    if (sub_ret == ESP_OK) {
        ESP_LOGI(TAG, "Subscribed to MQTT OTA topic: %s", OTA_MQTT_NOTIFY_TOPIC);
    } else {
        ESP_LOGE(TAG, "MQTT OTA topic %s not subscribed (%s) — check-now nudges ignored",
                 OTA_MQTT_NOTIFY_TOPIC, esp_err_to_name(sub_ret));
    }
#endif

    // Clean up previous stability timer if re-initializing
    if (s_stability_timer) {
        xTimerStop(s_stability_timer, 0);
        xTimerDelete(s_stability_timer, pdMS_TO_TICKS(100));
        s_stability_timer = NULL;
    }

    // Start rollback protection stability timer
    s_stability_timer = xTimerCreate("ota_stability", pdMS_TO_TICKS(OTA_STABILITY_TIMEOUT_MS),
                                     pdFALSE, NULL, ota_stability_timer_callback);
    if (s_stability_timer) {
        xTimerStart(s_stability_timer, 0);
        ESP_LOGI(TAG, "Rollback stability timer started (%d ms)", OTA_STABILITY_TIMEOUT_MS);
    }

    ESP_LOGI(TAG, "OTA manager initialized successfully");
    return ESP_OK;
}

esp_err_t ota_manager_check_update(void)
{
    if (!s_ota_task_handle) {
        ESP_LOGE(TAG, "OTA manager not initialized");
        return ESP_ERR_INVALID_STATE;
    }

    if (s_ota_in_progress) {
        ESP_LOGW(TAG, "OTA update already in progress");
        return ESP_ERR_INVALID_STATE;
    }

    ESP_LOGI(TAG, "Triggering manual update check");
    // Wakes ota_task() immediately instead of waiting for the periodic
    // timeout — this is the MQTT check-now nudge's whole mechanism.
    xTaskNotifyGive(s_ota_task_handle);
    return ESP_OK;
}

const char *ota_manager_get_version(void)
{
    const esp_app_desc_t *app_desc = esp_app_get_description();
    return app_desc->version;
}

const char *ota_manager_get_build_sha(void)
{
    return ROBOCAR_BUILD_SHA;
}

esp_err_t ota_manager_confirm_valid(void)
{
    if (s_firmware_valid_confirmed) {
        return ESP_OK;
    }

    esp_err_t ret = esp_ota_mark_app_valid_cancel_rollback();
    if (ret == ESP_OK) {
        s_firmware_valid_confirmed = true;
        ESP_LOGI(TAG, "Firmware marked as valid — rollback cancelled");
    } else {
        ESP_LOGW(TAG, "Failed to mark firmware valid: %s (may not be OTA boot)",
                 esp_err_to_name(ret));
    }
    return ret;
}

/**
 * Blocks on either the wait (OTA_FIRST_CHECK_DELAY_MS before the boot's first
 * check, the periodic interval after it) or an explicit notification
 * (ota_manager_check_update(), driven by the MQTT nudge), then runs one
 * check. Either wake reason runs the same check — a check-now nudge that
 * arrives mid-interval does not skip the next periodic one; it just moves it.
 */
static void ota_task(void *arg)
{
    (void)arg;

    // pdMS_TO_TICKS() on this project's non-SMP FreeRTOS kernel computes
    // (ms * configTICK_RATE_HZ) / 1000 entirely in TickType_t (uint32_t), so
    // feeding it OTA_CHECK_INTERVAL_MIN converted to milliseconds overflows
    // before the division runs — see ota_interval.h. Do the multiply in a
    // 64-bit intermediate instead, and fail closed to a short, known-safe
    // interval (never a silent truncation) if it still would not fit.
    uint32_t interval_ticks_u32 = 0;
    TickType_t interval_ticks;
    if (ota_interval_ticks_from_minutes((uint32_t)OTA_CHECK_INTERVAL_MIN,
                                        (uint32_t)configTICK_RATE_HZ, &interval_ticks_u32)) {
        interval_ticks = (TickType_t)interval_ticks_u32;
    } else {
        ESP_LOGE(
            TAG,
            "OTA_CHECK_INTERVAL_MIN=%d overflows a tick count at %d Hz — falling back to %d ms",
            OTA_CHECK_INTERVAL_MIN, (int)configTICK_RATE_HZ, OTA_INTERVAL_OVERFLOW_FALLBACK_MS);
        interval_ticks = pdMS_TO_TICKS(OTA_INTERVAL_OVERFLOW_FALLBACK_MS);
    }

    // The first check comes OTA_FIRST_CHECK_DELAY_MS after the task starts,
    // not a whole interval later: every reset restarted that countdown, so a
    // robot reset more often than OTA_CHECK_INTERVAL_MIN never checked (#1055).
    const TickType_t first_delay_ticks = pdMS_TO_TICKS(OTA_FIRST_CHECK_DELAY_MS);
    bool checked_yet = false;
    for (;;) {
        ulTaskNotifyTake(pdTRUE,
                         (TickType_t)ota_interval_next_wait_ticks(
                             checked_yet, (uint32_t)first_delay_ticks, (uint32_t)interval_ticks));
        checked_yet = true;
        run_update_check();
    }
}

/** HTTP response accumulator, same shape as gemini_http.c's — bounded copy
 *  into a caller-owned buffer, NUL-terminated, truncating (with a warning)
 *  rather than overrunning if the server sends more than expected. */
typedef struct {
    char *buf;
    size_t len;
    size_t cap;
} ota_http_acc_t;

static esp_err_t ota_http_event_handler(esp_http_client_event_t *evt)
{
    if (evt->event_id != HTTP_EVENT_ON_DATA) {
        return ESP_OK;
    }
    ota_http_acc_t *acc = (ota_http_acc_t *)evt->user_data;
    if (!acc || !acc->buf || !evt->data || evt->data_len <= 0) {
        return ESP_OK;
    }
    size_t avail = acc->cap - 1 - acc->len;
    size_t to_copy = ((size_t)evt->data_len < avail) ? (size_t)evt->data_len : avail;
    if (to_copy > 0) {
        memcpy(acc->buf + acc->len, evt->data, to_copy);
        acc->len += to_copy;
        acc->buf[acc->len] = '\0';
    }
    // cppcheck-suppress knownConditionTrueFalse // true when buffer fills (to_copy==avail<data_len)
    if (to_copy < (size_t)evt->data_len) {
        ESP_LOGW(TAG, "manifest response truncated — discarded %d bytes",
                 (int)((size_t)evt->data_len - to_copy));
    }
    return ESP_OK;
}

static esp_err_t fetch_manifest_json(char *buf, size_t buf_size, int *status_out)
{
    ota_http_acc_t acc = {.buf = buf, .len = 0, .cap = buf_size};
    buf[0] = '\0';

    esp_http_client_config_t cfg = {
        .url = OTA_MANIFEST_URL,
        .method = HTTP_METHOD_GET,
        .timeout_ms = OTA_HTTP_TIMEOUT_MS,
        .event_handler = ota_http_event_handler,
        .user_data = &acc,
        .crt_bundle_attach = esp_crt_bundle_attach,
    };

    esp_http_client_handle_t client = esp_http_client_init(&cfg);
    if (!client) {
        ESP_LOGE(TAG, "esp_http_client_init() failed for manifest fetch");
        return ESP_FAIL;
    }

    esp_err_t err = esp_http_client_perform(client);
    int status = esp_http_client_get_status_code(client);
    if (status_out) {
        *status_out = status;
    }
    esp_http_client_cleanup(client);

    if (err == ESP_OK && status != 200) {
        err = ESP_FAIL;
    }
    return err;
}

/**
 * The manifest's `builds[].parts[]` list is offsets-first (bootloader,
 * partition-table, optionally otadata, then the app), per
 * tools/generate-flasher-manifests.sh. The app binary is always the part
 * with the HIGHEST offset — this identifies it without hardcoding a filename
 * that would need to track appBinaryName from a flasher.json this firmware
 * never reads.
 */
static bool select_app_part_path(const cJSON *manifest, const char **path_out)
{
    const cJSON *builds = cJSON_GetObjectItemCaseSensitive(manifest, "builds");
    if (!cJSON_IsArray(builds)) {
        return false;
    }

    const cJSON *best_part = NULL;
    double best_offset = -1.0;

    const cJSON *build = NULL;
    cJSON_ArrayForEach(build, builds)
    {
        const cJSON *parts = cJSON_GetObjectItemCaseSensitive(build, "parts");
        if (!cJSON_IsArray(parts)) {
            continue;
        }
        const cJSON *part = NULL;
        cJSON_ArrayForEach(part, parts)
        {
            const cJSON *offset = cJSON_GetObjectItemCaseSensitive(part, "offset");
            const cJSON *path = cJSON_GetObjectItemCaseSensitive(part, "path");
            if (!cJSON_IsNumber(offset) || !cJSON_IsString(path) || !path->valuestring) {
                continue;
            }
            if (offset->valuedouble > best_offset) {
                best_offset = offset->valuedouble;
                best_part = path;
            }
        }
    }

    if (!best_part) {
        return false;
    }
    *path_out = best_part->valuestring;
    return true;
}

/**
 * Resolve a manifest part path relative to the manifest's OWN url, rather
 * than hardcoding a second copy of the Pages firmware directory — the part
 * path is everything after the manifest's final '/'.
 */
static bool resolve_relative_url(const char *base_url, const char *relative_path, char *out,
                                 size_t out_size)
{
    if (!base_url || !relative_path || !out || out_size == 0) {
        return false;
    }
    if (strstr(relative_path, "://") != NULL) {
        // Already absolute — pass through unchanged.
        return snprintf(out, out_size, "%s", relative_path) < (int)out_size;
    }

    const char *last_slash = strrchr(base_url, '/');
    if (!last_slash) {
        return false;
    }
    size_t dir_len = (size_t)(last_slash - base_url) + 1;  // include the slash
    if (dir_len >= out_size) {
        return false;
    }
    memcpy(out, base_url, dir_len);
    int written = snprintf(out + dir_len, out_size - dir_len, "%s", relative_path);
    return written > 0 && (dir_len + (size_t)written) < out_size;
}

static void run_update_check(void)
{
    ESP_LOGI(TAG, "Checking manifest for update: %s", OTA_MANIFEST_URL);

    char *manifest_buf = malloc(OTA_MANIFEST_BUF_SIZE);
    if (!manifest_buf) {
        ESP_LOGE(TAG, "Failed to allocate manifest buffer");
        return;
    }

    int status = 0;
    esp_err_t err = fetch_manifest_json(manifest_buf, OTA_MANIFEST_BUF_SIZE, &status);
    if (err != ESP_OK) {
        ESP_LOGW(TAG, "Manifest fetch failed: %s (HTTP %d)", esp_err_to_name(err), status);
        free(manifest_buf);
        return;
    }

    cJSON *manifest = cJSON_Parse(manifest_buf);
    free(manifest_buf);
    if (!manifest) {
        ESP_LOGW(TAG, "Manifest JSON parse failed");
        return;
    }

    const cJSON *version_node = cJSON_GetObjectItemCaseSensitive(manifest, "version");
    if (!cJSON_IsString(version_node) || !version_node->valuestring) {
        ESP_LOGW(TAG, "Manifest missing a usable \"version\" field");
        cJSON_Delete(manifest);
        return;
    }

    // Reject rather than silently truncate — a truncated string could parse
    // as a shorter, DIFFERENT version and compare as "newer" or "older" than
    // what the manifest actually published. See ota_version_fits().
    if (!ota_version_fits(version_node->valuestring, OTA_VERSION_STR_BUF_SIZE)) {
        ESP_LOGW(TAG,
                 "Manifest \"version\" is %zu bytes (max %d) — refusing to truncate; no update",
                 strlen(version_node->valuestring), OTA_VERSION_STR_BUF_SIZE - 1);
        cJSON_Delete(manifest);
        return;
    }

    char remote_version[OTA_VERSION_STR_BUF_SIZE];
    snprintf(remote_version, sizeof(remote_version), "%s", version_node->valuestring);
    const char *current_version = ota_manager_get_version();
    const char *current_sha = ota_manager_get_build_sha();

    // Absent from manifests written before issue #627; ota_update_decide()
    // refuses those (fail closed). Read in place — it is only compared and
    // logged before the manifest is freed below.
    const cJSON *sha_node = cJSON_GetObjectItemCaseSensitive(manifest, "buildSha");
    const char *remote_sha =
        (cJSON_IsString(sha_node) && sha_node->valuestring) ? sha_node->valuestring : NULL;

    const ota_update_decision_t decision =
        ota_update_decide(current_version, current_sha, remote_version, remote_sha);
    switch (decision) {
        case OTA_DECISION_UPDATE:
            break;
        case OTA_DECISION_INVALID_VERSION:
            ESP_LOGW(TAG, "Cannot compare versions (\"%s\" running vs \"%s\" manifest) — no update",
                     current_version, remote_version);
            break;
        case OTA_DECISION_REFUSE_MANIFEST_SHA_MISSING:
            ESP_LOGW(TAG,
                     "Manifest %s carries no valid \"buildSha\" — refusing to install a build "
                     "it cannot identify",
                     remote_version);
            break;
        case OTA_DECISION_UP_TO_DATE:
            ESP_LOGI(TAG, "No update available (running %s, build %s — the published build)",
                     current_version, current_sha);
            break;
        case OTA_DECISION_OLDER_REMOTE:
            ESP_LOGI(TAG, "No update available (running %s, manifest %s is older)", current_version,
                     remote_version);
            break;
        case OTA_DECISION_RUNNING_SHA_UNKNOWN:
            ESP_LOGI(TAG,
                     "Manifest %s matches the running version, but this build's SHA is \"%s\" — "
                     "cannot tell the builds apart; not installing",
                     remote_version, current_sha);
            break;
        case OTA_DECISION_REFUSE_SHA_MISMATCH:
            // remote_sha passed ota_build_sha_valid() to get here, so it is
            // exactly 40 hex digits and safe to log as-is.
            ESP_LOGW(TAG,
                     "Manifest %s is the running version built from a different commit "
                     "(running %s, published %s) — not installing unreleased changes under a "
                     "released version",
                     remote_version, current_sha, remote_sha);
            break;
    }
    if (decision == OTA_DECISION_REFUSE_MANIFEST_SHA_MISSING ||
        decision == OTA_DECISION_REFUSE_SHA_MISMATCH) {
        report_refusal(decision, remote_version);
    }
    if (decision != OTA_DECISION_UPDATE) {
        cJSON_Delete(manifest);
        return;
    }

    const char *part_path = NULL;
    char bin_url[OTA_BIN_URL_BUF_SIZE] = {0};
    bool resolved = select_app_part_path(manifest, &part_path) &&
                    resolve_relative_url(OTA_MANIFEST_URL, part_path, bin_url, sizeof(bin_url));

    /* What the update changes, for the announcement. Read before the
     * manifest is freed; a manifest without "notes" (published before they
     * were added) gives "Changes: not listed." */
    char *facts = malloc(OTA_FACTS_BUF_SIZE);
    if (facts) {
        const char *notes[OTA_ANNOUNCE_MAX_NOTES];
        size_t n_notes = 0;
        const cJSON *notes_node = cJSON_GetObjectItemCaseSensitive(manifest, "notes");
        const cJSON *item = NULL;
        cJSON_ArrayForEach(item, notes_node)
        {
            if (n_notes < OTA_ANNOUNCE_MAX_NOTES && cJSON_IsString(item) && item->valuestring) {
                notes[n_notes++] = item->valuestring;
            }
        }
        ota_announce_facts(remote_version, current_version, notes, n_notes, facts,
                           OTA_FACTS_BUF_SIZE);
    }
    cJSON_Delete(manifest);
    if (!resolved) {
        ESP_LOGE(TAG, "Manifest has no resolvable app binary part");
        free(facts);
        return;
    }

    ESP_LOGI(TAG, "Update available: %s -> %s (%s)", current_version, remote_version, bin_url);
    const bool go = announce_and_park(remote_version, facts ? facts : "");
    free(facts);
    if (!go) {
        set_phase(OTA_PHASE_IDLE);
        return;
    }
    start_https_ota(bin_url);
}

/* -------------------------------------------------------------------------
 * Before the install: wait for quiet, say what is coming, give the owner a
 * minute to postpone, then park on open floor and hold still.
 * ------------------------------------------------------------------------- */

static uint32_t now_ms(void)
{
    return (uint32_t)(esp_timer_get_time() / 1000);
}

static void set_phase(ota_phase_t phase)
{
    portENTER_CRITICAL(&s_flow_mux);
    s_phase = phase;
    portEXIT_CRITICAL(&s_flow_mux);
}

static void publish_status(const char *status)
{
#if MQTT_LOGGING_ENABLED
    char payload[OTA_STATUS_PAYLOAD_BUF_SIZE];
    snprintf(payload, sizeof(payload), "{\"status\":\"%s\",\"version\":\"%s\"}", status,
             s_pending_version);
    mqtt_logger_publish(OTA_MQTT_STATUS_TOPIC, payload, 1, false);
#else
    (void)status;
#endif
}

/** Nobody is talking to the robot and it is not speaking. */
static bool is_quiet(void)
{
    return !voice_turn_is_busy() && !voice_turn_in_conversation() && !audio_player_is_active();
}

/** Wait until speech posted now has played: the player starts within a few
 *  seconds (the TTS fetch), then goes idle for OTA_SPEECH_GAP_MS. */
static void wait_for_speech(void)
{
    const uint32_t start = now_ms();
    uint32_t idle_since = start;
    bool played = false;
    while ((uint32_t)(now_ms() - start) < OTA_SPEECH_WAIT_MS) {
        vTaskDelay(pdMS_TO_TICKS(OTA_POLL_MS));
        if (audio_player_is_active()) {
            played = true;
            idle_since = now_ms();
        } else if (played && (uint32_t)(now_ms() - idle_since) >= OTA_SPEECH_GAP_MS) {
            return;
        }
    }
    ESP_LOGW(TAG, "speech did not finish within %u ms; going on", (unsigned)OTA_SPEECH_WAIT_MS);
}

static reactive_manual_cmd_t park_manual_cmd(ota_park_cmd_t cmd)
{
    return (cmd == OTA_PARK_CMD_ROTATE) ? REACTIVE_MANUAL_ROTATE_CW : REACTIVE_MANUAL_FORWARD;
}

/** Drive ota_park to the end, then leave the executor hold on. */
static ota_park_result_t park(void)
{
    const ota_park_config_t cfg = OTA_PARK_CONFIG_DEFAULT;
    ota_park_t p;
    ota_park_start(&p, &cfg, now_ms());
    reactive_controller_set_hold(true);
    while (ota_park_result(&p) == OTA_PARK_RESULT_NONE) {
        reactive_telemetry_t t = {0};
        const bool have = reactive_controller_get_telemetry(&t) == ESP_OK;
        const bool rear_ok = have && !t.rear_failed && t.distance_rear_cm != ULTRASONIC_DIST_ERROR;
        const ota_park_cmd_t cmd = ota_park_step(
            &p, now_ms(), t.distance_cm, have && !t.sensor_failed, t.distance_rear_cm, rear_ok);
        if (cmd == OTA_PARK_CMD_STOP) {
            /* The hold, not a STOP lease: STOP hands the wheels back to the
             * planner's goal, which could drive off between turning steps. */
            reactive_controller_set_hold(true);
        } else {
            reactive_controller_set_hold(false);
            (void)reactive_controller_manual(park_manual_cmd(cmd), OTA_PARK_NUDGE_SPEED,
                                             OTA_PARK_LEASE_MS);
        }
        vTaskDelay(pdMS_TO_TICKS(OTA_PARK_TICK_MS));
    }
    reactive_controller_set_hold(true);
    return ota_park_result(&p);
}

static bool announce_and_park(const char *remote_version, const char *facts)
{
    portENTER_CRITICAL(&s_flow_mux);
    snprintf(s_pending_version, sizeof(s_pending_version), "%s", remote_version);
    portEXIT_CRITICAL(&s_flow_mux);

    /* 1. A quiet moment: never talk over a conversation. */
    set_phase(OTA_PHASE_WAITING_QUIET);
    const uint32_t wait_start = now_ms();
    while (!is_quiet()) {
        if ((uint32_t)(now_ms() - wait_start) >= OTA_QUIET_WAIT_MS) {
            ESP_LOGW(TAG, "no quiet moment in %u min; update %s waits for the next check",
                     (unsigned)(OTA_QUIET_WAIT_MS / 60000U), remote_version);
            publish_status("deferred_busy");
            return false;
        }
        vTaskDelay(pdMS_TO_TICKS(OTA_POLL_MS));
    }

    /* 2. What is coming, then the pun. */
    set_phase(OTA_PHASE_ANNOUNCING);
    const voice_persona_t *persona = voice_persona_get();
    const bool finnish =
        persona && persona->language_code && strncmp(persona->language_code, "fi", 2) == 0;
    char line[SPEECH_TEXT_MAX];
    if (gemini_backend_announce_update(facts, line, sizeof(line)) != ESP_OK || line[0] == '\0') {
        ota_announce_fallback(remote_version, finnish, line, sizeof(line));
    }
    ESP_LOGI(TAG, "announce: \"%s\" | facts: %s", line, facts);
    (void)speech_queue_post(line);
    (void)speech_queue_post(OTA_ANNOUNCE_PUN);
    publish_status("announced");
    wait_for_speech();

    /* 3. A minute to postpone (`ota postpone`). */
    portENTER_CRITICAL(&s_flow_mux);
    ota_window_open(&s_window, now_ms(), OTA_ANNOUNCE_WINDOW_MS);
    s_phase = OTA_PHASE_WINDOW;
    portEXIT_CRITICAL(&s_flow_mux);
    ESP_LOGI(TAG, "installing %s in %u s unless `ota postpone`", remote_version,
             (unsigned)(OTA_ANNOUNCE_WINDOW_MS / 1000U));
    for (;;) {
        portENTER_CRITICAL(&s_flow_mux);
        const ota_window_state_t st = ota_window_state(&s_window, now_ms());
        portEXIT_CRITICAL(&s_flow_mux);
        if (st == OTA_WINDOW_POSTPONED) {
            ESP_LOGI(TAG, "update %s postponed to the next check", remote_version);
            publish_status("postponed");
            return false;
        }
        if (st == OTA_WINDOW_EXPIRED) {
            break;
        }
        vTaskDelay(pdMS_TO_TICKS(OTA_POLL_MS));
    }

    /* 4. Open floor, then hold still through the download and the reboot. */
    set_phase(OTA_PHASE_PARKING);
    const ota_park_result_t parked = park();
    ESP_LOGI(TAG, "parked: %s (front %s) — holding still for the install",
             ota_park_result_name(parked),
             parked == OTA_PARK_RESULT_OPEN ? "open" : "not confirmed open");
    publish_status("parked");
    set_phase(OTA_PHASE_INSTALLING);
    return true;
}

esp_err_t ota_manager_postpone(void)
{
    portENTER_CRITICAL(&s_flow_mux);
    const bool ok = ota_window_postpone(&s_window, now_ms());
    portEXIT_CRITICAL(&s_flow_mux);
    return ok ? ESP_OK : ESP_ERR_INVALID_STATE;
}

ota_phase_t ota_manager_phase(void)
{
    portENTER_CRITICAL(&s_flow_mux);
    const ota_phase_t phase = s_phase;
    portEXIT_CRITICAL(&s_flow_mux);
    return phase;
}

void ota_manager_pending_version(char *out, size_t out_len)
{
    if (!out || out_len == 0) {
        return;
    }
    portENTER_CRITICAL(&s_flow_mux);
    snprintf(out, out_len, "%s", s_pending_version);
    portEXIT_CRITICAL(&s_flow_mux);
}

const char *ota_manager_phase_name(ota_phase_t phase)
{
    switch (phase) {
        case OTA_PHASE_WAITING_QUIET:
            return "waiting for a quiet moment";
        case OTA_PHASE_ANNOUNCING:
            return "announcing";
        case OTA_PHASE_WINDOW:
            return "postpone window open";
        case OTA_PHASE_PARKING:
            return "parking";
        case OTA_PHASE_INSTALLING:
            return "installing";
        case OTA_PHASE_IDLE:
        default:
            return "idle";
    }
}

static void start_https_ota(const char *bin_url)
{
    s_ota_in_progress = true;

#if MQTT_LOGGING_ENABLED
    mqtt_logger_publish(OTA_MQTT_STATUS_TOPIC, "{\"status\":\"downloading\"}", 1, false);
#endif

    esp_http_client_config_t http_cfg = {
        .url = bin_url,
        .timeout_ms = OTA_HTTP_TIMEOUT_MS,
        .crt_bundle_attach = esp_crt_bundle_attach,
        .keep_alive_enable = true,
    };
    esp_https_ota_config_t ota_cfg = {
        .http_config = &http_cfg,
    };

    ESP_LOGI(TAG, "Starting firmware update from %s", bin_url);
    esp_err_t ret = esp_https_ota(&ota_cfg);
    s_ota_in_progress = false;

    if (ret == ESP_OK) {
        ESP_LOGI(TAG, "Firmware update complete — rebooting...");
#if MQTT_LOGGING_ENABLED
        mqtt_logger_publish(OTA_MQTT_STATUS_TOPIC, "{\"status\":\"rebooting\"}", 1, false);
#endif
        // Brief delay to allow the MQTT message to send
        vTaskDelay(pdMS_TO_TICKS(500));
        esp_restart();
    } else {
        ESP_LOGE(TAG, "esp_https_ota() failed: %s", esp_err_to_name(ret));
#if MQTT_LOGGING_ENABLED
        mqtt_logger_publish(OTA_MQTT_STATUS_TOPIC, "{\"status\":\"failed\"}", 1, false);
#endif
        /* The running image is untouched (the download went to the other
         * slot), so let the robot move again and say so. */
        reactive_controller_set_hold(false);
        set_phase(OTA_PHASE_IDLE);
        const voice_persona_t *persona = voice_persona_get();
        const bool finnish =
            persona && persona->language_code && strncmp(persona->language_code, "fi", 2) == 0;
        (void)speech_queue_post(finnish ? OTA_ANNOUNCE_FAILED_FI : OTA_ANNOUNCE_FAILED_EN);
    }
}

/**
 * Publish a refusal on the OTA status topic, beside downloading / rebooting /
 * failed. Only the two refusals are reported: they mean the published
 * manifest and this robot disagree about what the build is, which nobody sees
 * from a log line on a board without a serial cable. remote_version has
 * already passed ota_version_compare(), so it holds only digits and dots.
 */
static void report_refusal(ota_update_decision_t decision, const char *remote_version)
{
#if MQTT_LOGGING_ENABLED
    char payload[OTA_STATUS_PAYLOAD_BUF_SIZE];
    snprintf(payload, sizeof(payload),
             "{\"status\":\"refused\",\"reason\":\"%s\",\"version\":\"%s\"}",
             ota_update_decision_name(decision), remote_version);
    mqtt_logger_publish(OTA_MQTT_STATUS_TOPIC, payload, 1, false);
#else
    (void)decision;
    (void)remote_version;
#endif
}

static void ota_stability_timer_callback(TimerHandle_t xTimer)
{
    (void)xTimer;
    ESP_LOGI(TAG, "Stability timeout reached — confirming firmware validity");
    ota_manager_confirm_valid();
}

#if MQTT_LOGGING_ENABLED
static void mqtt_ota_notify_handler(const char *topic, const char *data, int data_len)
{
    ESP_LOGI(TAG, "MQTT OTA notification received on topic: %s", topic);
    ESP_LOGI(TAG, "Notification data: %.*s", data_len, data);

    // Rate limit: at most one check per 60 seconds
    static int64_t s_last_ota_check_time = 0;
    int64_t now = esp_timer_get_time();
    if (s_last_ota_check_time > 0 && (now - s_last_ota_check_time) < 60 * 1000000LL) {
        ESP_LOGW(TAG, "MQTT OTA trigger rate-limited, skipping");
        return;
    }
    s_last_ota_check_time = now;

    esp_err_t ret = ota_manager_check_update();
    if (ret != ESP_OK) {
        ESP_LOGW(TAG, "Failed to trigger update check: %s", esp_err_to_name(ret));
    }
}
#endif
