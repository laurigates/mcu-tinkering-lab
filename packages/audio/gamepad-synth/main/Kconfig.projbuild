## packages/audio/gamepad-synth/main/Kconfig.projbuild
```kconfig
menu "Gamepad Synth"

config GAMEPAD_SYNTH_DEBUG_AXES
    bool "Enable verbose axis and dispatch diagnostic logging"
    default n
    help
        When enabled, the control task periodically logs raw gamepad axis
        values along with the current voicing, target frequency, and filter
        state. Each voicing function also logs the reason it called
        tone_stop (deadzone, no-face-button, arp-not-running, etc.), and
        the audio render task logs when the active flag transitions false.

        Intended to diagnose input-mapping bugs like the right-stick
        cardinal-axis cutoff. Noisy at 5 Hz — disable for normal use.

endmenu
```

## packages/audio/gamepad-synth/sdkconfig.defaults
```kconfig
# Gamepad Synth — sdkconfig defaults
CONFIG_IDF_TARGET="esp32s3"

# --- Bluepad32 (custom platform for BLE gamepad) ---
CONFIG_BLUEPAD32_PLATFORM_CUSTOM=y

# --- Bluetooth (Bluepad32 uses BTstack — disable NimBLE/Bluedroid) ---
CONFIG_BT_ENABLED=y
CONFIG_BT_BLUEDROID_ENABLED=n
CONFIG_BT_NIMBLE_ENABLED=n
CONFIG_BT_CONTROLLER_ONLY=y

# --- FreeRTOS ---
CONFIG_FREERTOS_HZ=1000
CONFIG_ESP_MAIN_TASK_STACK_SIZE=8192

# --- Flash ---
CONFIG_ESPTOOLPY_FLASHSIZE_4MB=y

# --- Console ---
# UART is the primary console so the vendored Bluepad32/btstack code
# (which references CONFIG_ESP_CONSOLE_UART_BAUDRATE unconditionally) compiles.
# USB-Serial-JTAG is kept as the secondary output so USB-C logging still works.
CONFIG_ESP_CONSOLE_UART_DEFAULT=y
CONFIG_ESP_CONSOLE_SECONDARY_USB_SERIAL_JTAG=y

# --- Compiler (suppress GCC 13+ warnings in vendored btstack) ---
CONFIG_COMPILER_DISABLE_GCC13_WARNINGS=y

# --- No WiFi needed ---
CONFIG_ESP_WIFI_ENABLED=n

# --- No PSRAM needed ---
CONFIG_SPIRAM=n

# --- Logging ---
CONFIG_LOG_DEFAULT_LEVEL_INFO=y

# --- Watchdog ---
CONFIG_ESP_TASK_WDT_TIMEOUT_S=10

# --- Power Management ---
CONFIG_PM_ENABLE=n
```

## packages/audio/kids-audio-toy/sdkconfig.defaults
```kconfig
# ESP32 Kids Audio Toy - SDK Configuration Defaults

# Enable ADC calibration for accurate potentiometer readings
CONFIG_ADC_CAL_EFUSE_TP_ENABLE=y
CONFIG_ADC_CAL_EFUSE_VREF_ENABLE=y

# Set log level (INFO for normal operation, DEBUG for troubleshooting)
CONFIG_LOG_DEFAULT_LEVEL_INFO=y

# FreeRTOS configuration
CONFIG_FREERTOS_HZ=1000

# Watchdog timers (increase if needed for debugging)
CONFIG_ESP_TASK_WDT_TIMEOUT_S=10
```

## packages/audio/melody-detector/sdkconfig.defaults
```kconfig
# XIAO ESP32-S3 Sense — Melody Detector
# See PRD-011 + ADR-017 for system-level decisions.

CONFIG_IDF_TARGET="esp32s3"

# PSRAM (XIAO ESP32-S3 Sense has 8MB Octal PSRAM — wrong mode = boot loop)
CONFIG_SPIRAM=y
CONFIG_SPIRAM_MODE_OCT=y
CONFIG_SPIRAM_SPEED_80M=y
CONFIG_SPIRAM_USE_MALLOC=y
CONFIG_SPIRAM_MALLOC_ALWAYSINTERNAL=16384
CONFIG_SPIRAM_MALLOC_RESERVE_INTERNAL=32768

# Flash
CONFIG_ESPTOOLPY_FLASHSIZE_8MB=y

# Custom partition table (OTA-capable; CI guards 1.75MB app size)
CONFIG_PARTITION_TABLE_CUSTOM=y
CONFIG_PARTITION_TABLE_CUSTOM_FILENAME="partitions.csv"

# OTA rollback support (WiFi/OTA wiring is deferred to v2; this flag costs nothing)
CONFIG_BOOTLOADER_APP_ROLLBACK_ENABLE=y

# USB Serial/JTAG console (XIAO native USB-C). Frees U0TX (GPIO43) and
# U0RX (GPIO44) for use as I2S LRC/DIN to the MAX98357A.
CONFIG_ESP_CONSOLE_USB_SERIAL_JTAG=y

# Main task stack — camera + I2S init plus eventual ESP-DL warmup
CONFIG_ESP_MAIN_TASK_STACK_SIZE=8192

# Camera DMA isolated to Core 1 so audio I2S DMA on Core 0 isn't disturbed
CONFIG_CAMERA_CORE1=y
CONFIG_CAMERA_DMA_BUFFER_SIZE_MAX=32768

# Brownout disabled — camera + flash LED inrush on weak USB ports trips it
CONFIG_ESP_BROWNOUT_DET=n

# Logging
CONFIG_LOG_DEFAULT_LEVEL_INFO=y
CONFIG_LOG_DEFAULT_LEVEL=3

# FreeRTOS
CONFIG_FREERTOS_HZ=1000

# Heap (no tracing in production builds)
CONFIG_HEAP_TRACING=n
CONFIG_HEAP_TASK_TRACKING=n
CONFIG_HEAP_POISONING_DISABLED=y
```

## packages/components/thinkpack-power/Kconfig.projbuild
```kconfig
menu "ThinkPack Power Monitor"

    config THINKPACK_POWER_ENABLE
        bool "Enable battery voltage monitor"
        default n
        help
            Enable the thinkpack-power runtime that periodically samples
            Vbat through ADC1 and classifies battery state (OK / LOW /
            CRITICAL).

            Disabled by default because no thinkpack reference board
            currently exposes a Vbat divider on a free ADC1 channel —
            on boombox and glowbug the only ADC1 pins (GPIO1, GPIO2)
            are already consumed by the pot_reader and light_sensor
            drivers, so leaving the monitor on would either silently
            fail (ADC unit collision) or read sensor input as battery
            voltage.

            Enable this once your board adds a Vbat divider on a free
            ADC1 channel. When enabling on a board that already uses
            ADC1 for sensors, supply the existing oneshot unit handle
            via power_config_t::adc_handle so the monitor shares the
            unit instead of trying to install a second driver.

    config THINKPACK_POWER_LOG_DISABLED_ONCE
        bool "Log a one-shot warning when init is called while disabled"
        default y
        depends on !THINKPACK_POWER_ENABLE
        help
            Emit a single ESP_LOGW from thinkpack_power_init() when the
            runtime is gated off, so the call site (e.g. boombox/glowbug
            main) doesn't appear silently unreachable in logs.

endmenu
```

## packages/esp32-projects/esp32-cam-i2s-audio/sdkconfig.defaults
```kconfig
# ESP32-CAM (AI-THINKER model defaults)
CONFIG_CAMERA_ENABLED=y
CONFIG_ESP32_CAMERA_SUPPORT=y
CONFIG_CAMERA_MODEL_AI_THINKER=y

# Default pins for AI-THINKER ESP32-CAM
# Verify these match your board.
CONFIG_CAMERA_PIN_PWDN=32
CONFIG_CAMERA_PIN_RESET=-1 # -1 if not connected
CONFIG_CAMERA_PIN_XCLK=0
CONFIG_CAMERA_PIN_SIOD=26
CONFIG_CAMERA_PIN_SIOC=27

CONFIG_CAMERA_PIN_D7=35
CONFIG_CAMERA_PIN_D6=34
CONFIG_CAMERA_PIN_D5=39
CONFIG_CAMERA_PIN_D4=36
CONFIG_CAMERA_PIN_D3=21
CONFIG_CAMERA_PIN_D2=19
CONFIG_CAMERA_PIN_D1=18
CONFIG_CAMERA_PIN_D0=5

CONFIG_CAMERA_PIN_VSYNC=25
CONFIG_CAMERA_PIN_HREF=23
CONFIG_CAMERA_PIN_PCLK=22

# Default camera settings
CONFIG_CAMERA_PIXEL_FORMAT_JPEG=y
CONFIG_CAMERA_FRAME_SIZE_UXGA=y # UXGA (1600x1200) is large, consider smaller for faster transfer
                                # e.g., CONFIG_CAMERA_FRAME_SIZE_SVGA=y (800x600) or VGA (640x480)

# Enable Wi-Fi
CONFIG_ESP_WIFI_ENABLED=y

# Enable TCP/IP Adapter
CONFIG_LWIP_ENET_SUPPORT=y

# Increase HTTP buffer size if needed for sending/receiving data
CONFIG_ESP_HTTP_CLIENT_ENABLE_HTTPS=y # If your server uses HTTPS
# CONFIG_HTTP_MAX_POST_LEN=2048 # Default is 1024, increase if sending larger headers/small bodies
# CONFIG_HTTP_MAX_RECV_LEN=2048 # Default is 512, increase if receiving larger responses

# For I2S Audio - these are general settings, specific driver config will be in code
CONFIG_USE_I2S_AUDIO=y # A conceptual flag, actual I2S config is via driver/i2s.h
```

## packages/esp32-projects/esp32-cam-webserver/sdkconfig.defaults
```kconfig
# ESP32-CAM (AI-THINKER model defaults)
CONFIG_CAMERA_ENABLED=y
CONFIG_ESP32_CAMERA_SUPPORT=y
CONFIG_CAMERA_MODEL_AI_THINKER=y

# Brownout detector configuration - Level 5 (2.70V) for better stability
CONFIG_ESP_BROWNOUT_DET=y
CONFIG_ESP_BROWNOUT_DET_LVL_SEL_5=y
CONFIG_ESP_BROWNOUT_DET_LVL=5

# Camera pin configuration
CONFIG_CAMERA_PIN_PWDN=32
CONFIG_CAMERA_PIN_RESET=-1
CONFIG_CAMERA_PIN_XCLK=0
CONFIG_CAMERA_PIN_SIOD=26
CONFIG_CAMERA_PIN_SIOC=27

CONFIG_CAMERA_PIN_D7=35
CONFIG_CAMERA_PIN_D6=34
CONFIG_CAMERA_PIN_D5=39
CONFIG_CAMERA_PIN_D4=36
CONFIG_CAMERA_PIN_D3=21
CONFIG_CAMERA_PIN_D2=19
CONFIG_CAMERA_PIN_D1=18
CONFIG_CAMERA_PIN_D0=5

CONFIG_CAMERA_PIN_VSYNC=25
CONFIG_CAMERA_PIN_HREF=23
CONFIG_CAMERA_PIN_PCLK=22

# PSRAM is required for camera applications
CONFIG_ESP32_SPIRAM_SUPPORT=y

# Wi-Fi configuration (canonical block — see .claude/skills/wifi-sta-setup)
CONFIG_ESP_WIFI_ENABLED=y
CONFIG_ESP_WIFI_STATIC_RX_BUFFER_NUM=10
CONFIG_ESP_WIFI_DYNAMIC_RX_BUFFER_NUM=32
CONFIG_ESP_WIFI_TX_BUFFER_TYPE=1
CONFIG_ESP_WIFI_DYNAMIC_TX_BUFFER_NUM=32
CONFIG_ESP_WIFI_AMPDU_TX_ENABLED=y
CONFIG_ESP_WIFI_AMPDU_RX_ENABLED=y
CONFIG_ESP_WIFI_AMSDU_TX_ENABLED=y
CONFIG_ESP_WIFI_NVS_ENABLED=y

# Brownout-justified TX power cap: AI-Thinker ESP32-CAM has documented
# brownout-during-WiFi-association issues; brownout detector is enabled above.
# See README.md "Power Considerations" and the 1-second power stabilization
# delay in app_main(). Do not remove without re-verifying brownout behaviour.
CONFIG_ESP_PHY_MAX_WIFI_TX_POWER=15
CONFIG_ESP_PHY_MAX_TX_POWER=15

# HTTP server configuration
CONFIG_HTTPD_MAX_REQ_HDR_LEN=1024
CONFIG_HTTPD_MAX_URI_LEN=512

# LWIP configuration for the web server
CONFIG_LWIP_MAX_SOCKETS=16
CONFIG_LWIP_SO_REUSE=y
CONFIG_LWIP_SO_REUSE_RXTOALL=y

# mDNS hostname discovery (esp32-cam.local)
CONFIG_MDNS_ENABLED=y

# Flash memory
CONFIG_ESPTOOLPY_FLASHSIZE_4MB=y
```

## packages/esp32-projects/esp32cam-llm-telegram/sdkconfig.defaults
```kconfig
# ESP32-CAM LLM Telegram Configuration

# ESP32-CAM specific
CONFIG_ESPTOOLPY_FLASHSIZE_4MB=y
CONFIG_ESPTOOLPY_FLASHFREQ_80M=y
CONFIG_ESPTOOLPY_FLASHMODE_DIO=y

# Camera Configuration
CONFIG_OV2640_SUPPORT=y
CONFIG_OV3660_SUPPORT=n
CONFIG_OV5640_SUPPORT=n
CONFIG_OV7670_SUPPORT=n
CONFIG_OV7725_SUPPORT=n
CONFIG_NT99141_SUPPORT=n
CONFIG_GC2145_SUPPORT=n
CONFIG_GC032A_SUPPORT=n
CONFIG_GC0308_SUPPORT=n
CONFIG_BF3005_SUPPORT=n
CONFIG_BF20A6_SUPPORT=n
CONFIG_SC101IOT_SUPPORT=n
CONFIG_SC030IOT_SUPPORT=n

# SPIRAM Configuration
CONFIG_ESP32_SPIRAM_SUPPORT=y
CONFIG_SPIRAM_SPEED_80M=y
CONFIG_SPIRAM_USE_MALLOC=y
CONFIG_SPIRAM_TYPE_AUTO=y
CONFIG_SPIRAM_SIZE=4194304
CONFIG_SPIRAM_CACHE_WORKAROUND=y

# HTTP Client Configuration
CONFIG_ESP_HTTP_CLIENT_ENABLE_HTTPS=y
CONFIG_ESP_HTTP_CLIENT_ENABLE_DIGEST_AUTH=y
CONFIG_ESP_TLS_INSECURE=y
CONFIG_ESP_TLS_SKIP_SERVER_CERT_VERIFY=y

# Partition Table
CONFIG_PARTITION_TABLE_CUSTOM=y
CONFIG_PARTITION_TABLE_CUSTOM_FILENAME="partitions.csv"
CONFIG_PARTITION_TABLE_FILENAME="partitions.csv"

# WiFi Configuration
CONFIG_ESP32_WIFI_STATIC_RX_BUFFER_NUM=10
CONFIG_ESP32_WIFI_DYNAMIC_RX_BUFFER_NUM=32
CONFIG_ESP32_WIFI_DYNAMIC_TX_BUFFER_NUM=32
CONFIG_ESP32_WIFI_TX_BA_WIN=6
CONFIG_ESP32_WIFI_RX_BA_WIN=6
CONFIG_ESP32_WIFI_AMPDU_TX_ENABLED=y
CONFIG_ESP32_WIFI_AMPDU_RX_ENABLED=y

# FreeRTOS
CONFIG_FREERTOS_HZ=1000
CONFIG_FREERTOS_USE_TRACE_FACILITY=y
CONFIG_FREERTOS_USE_STATS_FORMATTING_FUNCTIONS=y

# mbedTLS
CONFIG_MBEDTLS_SSL_MAX_CONTENT_LEN=16384
CONFIG_MBEDTLS_CERTIFICATE_BUNDLE=y
CONFIG_MBEDTLS_CERTIFICATE_BUNDLE_DEFAULT_FULL=y

# Logging
CONFIG_LOG_DEFAULT_LEVEL_INFO=y
CONFIG_LOG_COLORS=y

# LWIP
CONFIG_LWIP_MAX_SOCKETS=10
CONFIG_LWIP_SO_REUSE=y
CONFIG_LWIP_SO_RCVBUF=y

# ESP System
CONFIG_ESP_MAIN_TASK_STACK_SIZE=8192
CONFIG_ESP_TASK_WDT_TIMEOUT_S=30
```

## packages/esp32-projects/esp32s3-gemini-vision/sdkconfig.defaults
```kconfig
# XIAO ESP32-S3 Sense — Gemini Vision
CONFIG_IDF_TARGET="esp32s3"

# PSRAM (XIAO ESP32-S3 Sense has 8MB Octal PSRAM)
CONFIG_SPIRAM=y
CONFIG_SPIRAM_MODE_OCT=y
CONFIG_SPIRAM_SPEED_80M=y
CONFIG_SPIRAM_USE_MALLOC=y
CONFIG_SPIRAM_MALLOC_ALWAYSINTERNAL=16384
CONFIG_SPIRAM_MALLOC_RESERVE_INTERNAL=32768

# Flash (XIAO ESP32-S3 Sense has 8MB flash)
CONFIG_ESPTOOLPY_FLASHSIZE_8MB=y

# Custom partition table
CONFIG_PARTITION_TABLE_CUSTOM=y
CONFIG_PARTITION_TABLE_CUSTOM_FILENAME="partitions.csv"

# USB Serial/JTAG console (XIAO native USB-C)
CONFIG_ESP_CONSOLE_USB_SERIAL_JTAG=y

# Main task stack (WiFi + camera + httpd + HTTPS)
CONFIG_ESP_MAIN_TASK_STACK_SIZE=8192

# HTTP server tuning
CONFIG_HTTPD_MAX_URI_LEN=512
CONFIG_HTTPD_MAX_REQ_HDR_LEN=1024

# HTTPS client for Gemini API
CONFIG_ESP_HTTP_CLIENT_ENABLE_HTTPS=y
CONFIG_ESP_TLS_USING_MBEDTLS=y
CONFIG_MBEDTLS_CERTIFICATE_BUNDLE=y
CONFIG_MBEDTLS_CERTIFICATE_BUNDLE_DEFAULT_FULL=y

# Camera DMA isolated to Core 1
CONFIG_CAMERA_CORE1=y
CONFIG_CAMERA_DMA_BUFFER_SIZE_MAX=32768

# mDNS
CONFIG_MDNS_ENABLED=y

# Brownout disabled (camera + WiFi startup can dip voltage on some USB ports)
CONFIG_ESP_BROWNOUT_DET=n

# WiFi tuning — mirrors robocar-unified which runs reliably on XIAO S3 Sense.
# Larger RX buffers reduce drops during bursty traffic; amsdu/ampdu off avoids
# aggregation edge cases some APs mis-handle.
CONFIG_ESP_WIFI_STATIC_RX_BUFFER_NUM=10
CONFIG_ESP_WIFI_DYNAMIC_RX_BUFFER_NUM=32
CONFIG_ESP_WIFI_TX_BUFFER_TYPE=1
CONFIG_ESP_WIFI_DYNAMIC_TX_BUFFER_NUM=32
CONFIG_ESP_WIFI_AMPDU_TX_ENABLED=n
CONFIG_ESP_WIFI_AMPDU_RX_ENABLED=n
CONFIG_ESP_WIFI_AMSDU_TX_ENABLED=n
CONFIG_ESP_WIFI_NVS_ENABLED=y

# Cap TX power — in tight USB supplies the radio at max power can brown the
# 3.3V rail during handshake bursts, which presents as 4-way handshake timeout.
CONFIG_ESP_PHY_MAX_WIFI_TX_POWER=15

# Logging
CONFIG_LOG_DEFAULT_LEVEL_INFO=y
CONFIG_LOG_DEFAULT_LEVEL=3

# FreeRTOS
CONFIG_FREERTOS_HZ=1000
```

## packages/esp32-projects/it-troubleshooter/sdkconfig.defaults
```kconfig
# IT Troubleshooter - ESP32-S3 Configuration
# Target: Waveshare ESP32-S3-Zero

CONFIG_IDF_TARGET="esp32s3"

# --- USB (TinyUSB composite: HID keyboard + CDC serial) ---
CONFIG_TINYUSB_ENABLED=y
CONFIG_TINYUSB_HID_ENABLED=y
CONFIG_TINYUSB_HID_COUNT=1
CONFIG_TINYUSB_CDC_ENABLED=y
CONFIG_TINYUSB_CDC_COUNT=1
CONFIG_TINYUSB_DESC_USE_ESPRESSIF_VID=n
CONFIG_TINYUSB_DESC_USE_DEFAULT_PID=n

# --- FreeRTOS ---
CONFIG_FREERTOS_HZ=1000

# --- Flash & PSRAM (Waveshare ESP32-S3-Zero: 4MB flash, 2MB PSRAM) ---
CONFIG_ESPTOOLPY_FLASHSIZE_4MB=y
CONFIG_PARTITION_TABLE_SINGLE_APP=y

# --- PSRAM (2MB on ESP32-S3-Zero) ---
CONFIG_SPIRAM=y
CONFIG_SPIRAM_MODE_QUAD=y
CONFIG_SPIRAM_SPEED_80M=y

# --- Logging ---
CONFIG_LOG_DEFAULT_LEVEL_INFO=y

# --- Watchdog ---
CONFIG_ESP_TASK_WDT_TIMEOUT_S=10

# --- WiFi ---
CONFIG_ESP_WIFI_ENABLED=y
CONFIG_ESP_WIFI_STATIC_RX_BUFFER_NUM=10
CONFIG_ESP_WIFI_DYNAMIC_TX_BUFFER_NUM=32
CONFIG_ESP_WIFI_SOFTAP_SUPPORT=n

# --- Power Management --- disabled for lowest latency
CONFIG_PM_ENABLE=n
```

## packages/esp32-projects/nfc-scavenger-hunt/sdkconfig.defaults
```kconfig
# Target: ESP32-S3
CONFIG_IDF_TARGET="esp32s3"

# mDNS hostname discovery (nfc-scavenger-hunt.local)
CONFIG_MDNS_ENABLED=y

# Main task stack — needs headroom for WiFi + TLS + HTTPS init
CONFIG_ESP_MAIN_TASK_STACK_SIZE=8192

# PSRAM support (critical for audio buffering)
CONFIG_SPIRAM=y
CONFIG_SPIRAM_MODE_OCT=y
CONFIG_SPIRAM_SPEED_80M=y
CONFIG_SPIRAM_TRY_ALLOCATE_WIFI_LWIP=y

# Allow malloc from PSRAM when internal RAM is exhausted
CONFIG_SPIRAM_USE_CAPS_ALLOC=y

# WiFi (canonical block — see .claude/skills/wifi-sta-setup/SKILL.md)
CONFIG_ESP_WIFI_STATIC_RX_BUFFER_NUM=10
CONFIG_ESP_WIFI_DYNAMIC_RX_BUFFER_NUM=32
CONFIG_ESP_WIFI_TX_BUFFER_TYPE=1
CONFIG_ESP_WIFI_DYNAMIC_TX_BUFFER_NUM=32
CONFIG_ESP_WIFI_AMPDU_TX_ENABLED=y
CONFIG_ESP_WIFI_AMPDU_RX_ENABLED=y
CONFIG_ESP_WIFI_AMSDU_TX_ENABLED=y
CONFIG_ESP_WIFI_NVS_ENABLED=y

# TLS — full certificate bundle for Google API HTTPS
CONFIG_MBEDTLS_CERTIFICATE_BUNDLE=y
CONFIG_MBEDTLS_CERTIFICATE_BUNDLE_DEFAULT_FULL=y

# HTTP client
CONFIG_ESP_HTTP_CLIENT_ENABLE_HTTPS=y

# Larger HTTP buffer for Gemini JSON responses
CONFIG_ESP_HTTP_CLIENT_ENABLE_BASIC_AUTH=n

# FreeRTOS
CONFIG_FREERTOS_HZ=1000

# Log level
CONFIG_LOG_DEFAULT_LEVEL_INFO=y

# Watchdog — generous timeout for TLS handshake
CONFIG_ESP_TASK_WDT_TIMEOUT_S=30

# NVS encryption not needed for home toy
CONFIG_NVS_ENCRYPTION=n

# Partition table — default single factory app
CONFIG_PARTITION_TABLE_SINGLE_APP=y

# Flash size (match board: 4MB SuperMini, 8MB XIAO)
CONFIG_ESPTOOLPY_FLASHSIZE_4MB=y
```
