## packages/esp32-projects/robocar-camera/main/Kconfig.projbuild
```kconfig
menu "ESP32-CAM Robocar Configuration"

    choice AI_BACKEND
        prompt "AI Backend Selection"
        default AI_BACKEND_OLLAMA
        help
            Select which AI backend to use for image analysis.

        config AI_BACKEND_CLAUDE
            bool "Claude API"
            help
                Use Claude API for image analysis. Requires API key and internet connection.

        config AI_BACKEND_OLLAMA
            bool "Ollama"
            help
                Use local or remote Ollama server for image analysis.
                Supports service discovery via mDNS.
    endchoice

    config CONFIG_AI_BACKEND_CLAUDE
        bool
        default y if AI_BACKEND_CLAUDE

    config CONFIG_AI_BACKEND_OLLAMA
        bool
        default y if AI_BACKEND_OLLAMA

endmenu

menu "OTA Update Configuration"

    config OTA_GITHUB_ORG
        string "GitHub organization or username"
        default "laurigates"
        help
            The GitHub organization or username that owns the repository.

    config OTA_GITHUB_REPO
        string "GitHub repository name"
        default "mcu-tinkering-lab"
        help
            The GitHub repository name where firmware releases are published.

endmenu
```

## packages/esp32-projects/robocar-main/sdkconfig.defaults
```kconfig
# Heltec WiFi LoRa 32 V1 Main Controller Configuration

# OTA Support
CONFIG_BOOTLOADER_APP_ROLLBACK_ENABLE=y
CONFIG_MBEDTLS_CERTIFICATE_BUNDLE_DEFAULT_FULL=y
CONFIG_ESP_HTTPS_OTA_ALLOW_HTTP=n

# mDNS hostname discovery (robocar-main.local)
CONFIG_MDNS_ENABLED=y

# Main task stack size
CONFIG_ESP_MAIN_TASK_STACK_SIZE=8192

# Canonical WiFi STA buffer/NVS configuration (see .claude/skills/wifi-sta-setup)
CONFIG_ESP_WIFI_STATIC_RX_BUFFER_NUM=10
CONFIG_ESP_WIFI_DYNAMIC_RX_BUFFER_NUM=32
CONFIG_ESP_WIFI_TX_BUFFER_TYPE=1
CONFIG_ESP_WIFI_DYNAMIC_TX_BUFFER_NUM=32
CONFIG_ESP_WIFI_AMPDU_TX_ENABLED=n
CONFIG_ESP_WIFI_AMPDU_RX_ENABLED=n
CONFIG_ESP_WIFI_AMSDU_TX_ENABLED=n
CONFIG_ESP_WIFI_NVS_ENABLED=y
```

## packages/esp32-projects/xbox-switch-bridge/main/Kconfig.projbuild
```kconfig
menu "Xbox-Switch Bridge"

    config TINYUSB_ENABLED
        bool "Enable TinyUSB (Switch Pro Controller emulation)"
        default y
        help
            Enable USB HID device mode via TinyUSB to emulate a Switch Pro
            Controller. Disable for wifi-test builds where USB-Serial-JTAG
            is needed for monitoring.

endmenu
```

## packages/esp32-projects/xbox-switch-bridge/sdkconfig.defaults
```kconfig
# Xbox-Switch Bridge - ESP32-S3 Configuration
# Target: ESP32-S3

CONFIG_IDF_TARGET="esp32s3"

# --- Bluepad32 ---
CONFIG_BLUEPAD32_PLATFORM_CUSTOM=y

# --- Bluetooth (required for Bluepad32) ---
CONFIG_BT_ENABLED=y
CONFIG_BT_BLUEDROID_ENABLED=n
CONFIG_BT_NIMBLE_ENABLED=y
CONFIG_BT_CONTROLLER_ENABLED=y
CONFIG_BTDM_CTRL_MODE_BLE_ONLY=y

# Bluepad32 requires classic BT for some controllers, but Xbox Series
# uses BLE. Enable both for maximum compatibility.
CONFIG_BT_NIMBLE_MAX_CONNECTIONS=4
CONFIG_BT_NIMBLE_ROLE_CENTRAL=y
CONFIG_BT_NIMBLE_ROLE_OBSERVER=y

# --- USB (TinyUSB for Switch Pro Controller emulation) ---
# USB-Serial-JTAG and USB-OTG share one PHY on ESP32-S3.
# Disable USB-Serial-JTAG so TinyUSB can claim the PHY exclusively.
CONFIG_USJ_ENABLE_USB_SERIAL_JTAG=n
CONFIG_ESP_CONSOLE_SECONDARY_NONE=y
CONFIG_TINYUSB_ENABLED=y
CONFIG_TINYUSB_HID_ENABLED=y
CONFIG_TINYUSB_HID_COUNT=1
CONFIG_TINYUSB_DESC_USE_ESPRESSIF_VID=n
CONFIG_TINYUSB_DESC_USE_DEFAULT_PID=n

# --- FreeRTOS ---
CONFIG_FREERTOS_HZ=1000

# --- Flash & PSRAM (Waveshare ESP32-S3-Zero: 4MB flash, 2MB PSRAM) ---
CONFIG_ESPTOOLPY_FLASHSIZE_4MB=y
CONFIG_PARTITION_TABLE_CUSTOM=y
CONFIG_PARTITION_TABLE_CUSTOM_FILENAME="partitions.csv"

# --- PSRAM (2MB PSRAM on ESP32-S3-Zero) ---
CONFIG_SPIRAM=y
CONFIG_SPIRAM_MODE_QUAD=y
CONFIG_SPIRAM_SPEED_80M=y

# --- Compiler (suppress GCC 13+ warnings in vendored btstack) ---
CONFIG_COMPILER_DISABLE_GCC13_WARNINGS=y


# --- WiFi (for UDP log forwarding during development) ---
# ESP32-S3 supports concurrent WiFi + BT via software coexistence.
CONFIG_ESP_WIFI_ENABLED=y
CONFIG_ESP_WIFI_ENABLE_WPA3_SAE=y
CONFIG_ESP_WIFI_ENABLE_SAE_PK=y
CONFIG_WPA_11KV_SUPPORT=y
CONFIG_ESP_COEX_SW_COEXIST_ENABLE=y

# --- Logging ---
CONFIG_LOG_DEFAULT_LEVEL_INFO=y

# --- Watchdog ---
CONFIG_ESP_TASK_WDT_TIMEOUT_S=10

# --- Power Management ---
# Disable power management for lowest latency
CONFIG_PM_ENABLE=n
```

## packages/input-gaming/switch-usb-proxy/sdkconfig.defaults
```kconfig
# Target: ESP32-S3
CONFIG_IDF_TARGET="esp32s3"

# USB PHY: TinyUSB owns the PHY (disables USB-Serial-JTAG)
CONFIG_USJ_ENABLE_USB_SERIAL_JTAG=n
CONFIG_ESP_CONSOLE_SECONDARY_NONE=y

# TinyUSB configuration
CONFIG_TINYUSB_HID_COUNT=1
CONFIG_TINYUSB_DESC_USE_ESPRESSIF_VID=n
CONFIG_TINYUSB_DESC_USE_DEFAULT_PID=n

# Stack size: enough for USB + UART init
CONFIG_ESP_MAIN_TASK_STACK_SIZE=8192
CONFIG_FREERTOS_HZ=1000

# UART for PC communication (115200 default, can go higher)
# GPIO43 = TX, GPIO44 = RX (directly accessible on most S3 dev boards)

# No Bluetooth needed for proxy mode
CONFIG_BT_ENABLED=n

# No WiFi needed
CONFIG_ESP_WIFI_ENABLED=n
```

## packages/input-gaming/xbox-switch-bridge/sdkconfig.defaults
```kconfig
# Xbox-Switch Bridge - ESP32-S3 Configuration
# Target: ESP32-S3

CONFIG_IDF_TARGET="esp32s3"

# --- Bluepad32 ---
CONFIG_BLUEPAD32_PLATFORM_CUSTOM=y

# --- Bluetooth (required for Bluepad32) ---
CONFIG_BT_ENABLED=y
CONFIG_BT_BLUEDROID_ENABLED=n
CONFIG_BT_NIMBLE_ENABLED=y
CONFIG_BT_CONTROLLER_ENABLED=y

# Bluepad32 requires classic BT for some controllers, but Xbox Series
# uses BLE. Enable both for maximum compatibility.
CONFIG_BT_NIMBLE_MAX_CONNECTIONS=4
CONFIG_BT_NIMBLE_ROLE_CENTRAL=y
CONFIG_BT_NIMBLE_ROLE_OBSERVER=y

# --- USB (TinyUSB for Switch Pro Controller emulation) ---
# USB-Serial-JTAG and USB-OTG share one PHY on ESP32-S3.
# Disable USB-Serial-JTAG so TinyUSB can claim the PHY exclusively.
CONFIG_USJ_ENABLE_USB_SERIAL_JTAG=n
CONFIG_ESP_CONSOLE_SECONDARY_NONE=y
CONFIG_TINYUSB_HID_COUNT=1
CONFIG_TINYUSB_DESC_USE_ESPRESSIF_VID=n
CONFIG_TINYUSB_DESC_USE_DEFAULT_PID=n

# --- FreeRTOS ---
CONFIG_FREERTOS_HZ=1000
CONFIG_ESP_MAIN_TASK_STACK_SIZE=8192

# --- Flash & PSRAM (Waveshare ESP32-S3-Zero: 4MB flash, 2MB PSRAM) ---
CONFIG_ESPTOOLPY_FLASHSIZE_4MB=y
CONFIG_PARTITION_TABLE_CUSTOM=y
CONFIG_PARTITION_TABLE_CUSTOM_FILENAME="partitions.csv"

# --- PSRAM (2MB PSRAM on ESP32-S3-Zero) ---
CONFIG_SPIRAM=y
CONFIG_SPIRAM_MODE_QUAD=y
CONFIG_SPIRAM_SPEED_80M=y

# --- Compiler (suppress GCC 13+ warnings in vendored btstack) ---
CONFIG_COMPILER_DISABLE_GCC13_WARNINGS=y


# --- WiFi (for UDP log forwarding during development) ---
# ESP32-S3 supports concurrent WiFi + BT via software coexistence.
# NOTE: BLE + SoftAP is "C1: unstable" per Espressif coexistence matrix.
# Pin WiFi to core 1 (BT on core 0) to reduce contention.
CONFIG_ESP_WIFI_ENABLED=y
CONFIG_ESP_COEX_SW_COEXIST_ENABLE=y
CONFIG_ESP_WIFI_TASK_PINNED_TO_CORE_1=y
CONFIG_ESP_WIFI_TASK_PINNED_TO_CORE_0=n

# ESP32-S3 SoftAP workarounds:
# - AMPDU causes AP invisibility on S3 (espressif/esp-idf#13508, ESP-FAQ)
# - WiFi NVS causes client connect/disconnect loops on S3 (espressif/esp-idf#8008)
CONFIG_ESP_WIFI_AMPDU_RX_ENABLED=n
CONFIG_ESP_WIFI_AMPDU_TX_ENABLED=n
CONFIG_ESP_WIFI_NVS_ENABLED=n

# Reduce static WiFi buffer counts to reclaim internal DRAM.
# With PSRAM enabled, WiFi TX/RX buffers are forced into internal RAM
# (not PSRAM), competing with BTstack + TinyUSB (espressif/esp-idf#6467).
CONFIG_ESP_WIFI_STATIC_RX_BUFFER_NUM=6
CONFIG_ESP_WIFI_STATIC_TX_BUFFER_NUM=8

# Disable unneeded WiFi features to reduce memory pressure
# (open AP doesn't need WPA3, 802.11k/v, or enterprise support)
CONFIG_ESP_WIFI_ENABLE_WPA3_SAE=n
CONFIG_ESP_WIFI_ENABLE_SAE_PK=n
CONFIG_ESP_WIFI_11KV_SUPPORT=n

# --- Logging ---
CONFIG_LOG_DEFAULT_LEVEL_INFO=y

# --- Watchdog ---
CONFIG_ESP_TASK_WDT_TIMEOUT_S=10

# --- Power Management ---
# Disable power management for lowest latency
CONFIG_PM_ENABLE=n
```

## packages/robocar/main/main/Kconfig.projbuild
```kconfig
menu "OTA Update Configuration"

    config OTA_GITHUB_ORG
        string "GitHub organization or username"
        default "laurigates"
        help
            The GitHub organization or username that owns the repository.

    config OTA_GITHUB_REPO
        string "GitHub repository name"
        default "mcu-tinkering-lab"
        help
            The GitHub repository name where firmware releases are published.

endmenu
```

## packages/thinkpack/boombox/sdkconfig.defaults
```kconfig
# ESP32-S3 target
CONFIG_IDF_TARGET="esp32s3"

# USB-Serial-JTAG for monitoring
CONFIG_ESP_CONSOLE_UART_DEFAULT=y

# WiFi — required by ESP-NOW
CONFIG_ESP_WIFI_ENABLED=y

# Enable ESP-NOW (part of esp_wifi; on by default but documented here)
CONFIG_ESP_WIFI_ESPNOW_ENABLED=y

# Disable WiFi AMPDU (known S3 AP visibility workaround)
CONFIG_ESP_WIFI_AMPDU_RX_ENABLED=n
CONFIG_ESP_WIFI_AMPDU_TX_ENABLED=n

# Disable WiFi NVS storage
CONFIG_ESP_WIFI_NVS_ENABLED=n

# Reduce WiFi buffers
CONFIG_ESP_WIFI_STATIC_RX_BUFFER_NUM=4
CONFIG_ESP_WIFI_DYNAMIC_RX_BUFFER_NUM=8
CONFIG_ESP_WIFI_DYNAMIC_TX_BUFFER_NUM=8

# Disable 11kv
CONFIG_ESP_WIFI_11KV_SUPPORT=n

# Disable Bluetooth entirely
CONFIG_BT_ENABLED=n

# No PSRAM
CONFIG_SPIRAM=n

# Default partition table (no custom partitions.csv)
CONFIG_PARTITION_TABLE_SINGLE_APP=y

# Logging level
CONFIG_LOG_DEFAULT_LEVEL_INFO=y

# Larger main task stack for WiFi + ESP-NOW init
CONFIG_ESP_MAIN_TASK_STACK_SIZE=8192

# ADC oneshot requires calibration data in eFuse
CONFIG_ADC_CAL_EFUSE_VREF_ENABLE=y
CONFIG_ADC_CAL_EFUSE_TP_ENABLE=y
CONFIG_ADC_CAL_LUT_ENABLE=y
```

## packages/thinkpack/brainbox/main/Kconfig.projbuild
```kconfig
menu "ThinkPack Brainbox Configuration"

    choice AI_BACKEND
        prompt "AI Backend Selection"
        default AI_BACKEND_OLLAMA
        help
            Select which AI backend Brainbox uses to generate collective-play
            directives.

        config AI_BACKEND_CLAUDE
            bool "Claude API"
            help
                Use Claude API for text generation. Requires API key and WiFi.

        config AI_BACKEND_OLLAMA
            bool "Ollama"
            help
                Use local or remote Ollama server. Supports mDNS discovery.

        config AI_BACKEND_GEMINI
            bool "Gemini"
            help
                Use Google Gemini. Requires Gemini API key.
    endchoice

    config CONFIG_AI_BACKEND_CLAUDE
        bool
        default y if AI_BACKEND_CLAUDE

    config CONFIG_AI_BACKEND_OLLAMA
        bool
        default y if AI_BACKEND_OLLAMA

    config CONFIG_AI_BACKEND_GEMINI
        bool
        default y if AI_BACKEND_GEMINI

endmenu
```

## packages/thinkpack/chatterbox/sdkconfig.defaults
```kconfig
# ESP32-S3 target (SuperMini variant — DIO flash / octal PSRAM)
CONFIG_IDF_TARGET="esp32s3"

# USB-Serial-JTAG for monitoring / flashing
CONFIG_ESP_CONSOLE_UART_DEFAULT=y

# WiFi — required by ESP-NOW
CONFIG_ESP_WIFI_ENABLED=y
CONFIG_ESP_WIFI_ESPNOW_ENABLED=y

# Disable WiFi AMPDU (S3 AP visibility workaround also applies to ESP-NOW peering)
CONFIG_ESP_WIFI_AMPDU_RX_ENABLED=n
CONFIG_ESP_WIFI_AMPDU_TX_ENABLED=n

# Chatterbox is ESP-NOW only — no STA credentials persisted
CONFIG_ESP_WIFI_NVS_ENABLED=n

# Reduce WiFi buffers to make room for audio in RAM
CONFIG_ESP_WIFI_STATIC_RX_BUFFER_NUM=4
CONFIG_ESP_WIFI_DYNAMIC_RX_BUFFER_NUM=8
CONFIG_ESP_WIFI_DYNAMIC_TX_BUFFER_NUM=8
CONFIG_ESP_WIFI_11KV_SUPPORT=n

# No Bluetooth
CONFIG_BT_ENABLED=n

# PSRAM — required for the 2 s clip buffer (32000 samples × 2 bytes = 64 KB)
#
# SuperMini ESP32-S3 boards ship with octal PSRAM; swap to _MODE_QUAD if you
# are using a QIO variant.
CONFIG_SPIRAM=y
CONFIG_SPIRAM_MODE_OCT=y
CONFIG_SPIRAM_SPEED_80M=y
CONFIG_SPIRAM_USE_CAPS_ALLOC=y

# Partition table — default single factory app is fine for now
CONFIG_PARTITION_TABLE_SINGLE_APP=y

# Logging level
CONFIG_LOG_DEFAULT_LEVEL_INFO=y

# Larger main task stack for WiFi + ESP-NOW + I2S init in a single task
CONFIG_ESP_MAIN_TASK_STACK_SIZE=8192

# Flash size (SuperMini 4 MB)
CONFIG_ESPTOOLPY_FLASHSIZE_4MB=y
```

## packages/thinkpack/glowbug/sdkconfig.defaults
```kconfig
# ESP32-S3 target
CONFIG_IDF_TARGET="esp32s3"

# USB-Serial-JTAG for monitoring
CONFIG_ESP_CONSOLE_UART_DEFAULT=y

# WiFi — required by ESP-NOW
CONFIG_ESP_WIFI_ENABLED=y

# Enable ESP-NOW (part of esp_wifi; on by default but documented here)
CONFIG_ESP_WIFI_ESPNOW_ENABLED=y

# Disable WiFi AMPDU (known S3 AP visibility workaround)
CONFIG_ESP_WIFI_AMPDU_RX_ENABLED=n
CONFIG_ESP_WIFI_AMPDU_TX_ENABLED=n

# Disable WiFi NVS storage
CONFIG_ESP_WIFI_NVS_ENABLED=n

# Reduce WiFi buffers
CONFIG_ESP_WIFI_STATIC_RX_BUFFER_NUM=4
CONFIG_ESP_WIFI_DYNAMIC_RX_BUFFER_NUM=8
CONFIG_ESP_WIFI_DYNAMIC_TX_BUFFER_NUM=8

# Disable 11kv
CONFIG_ESP_WIFI_11KV_SUPPORT=n

# Disable Bluetooth entirely
CONFIG_BT_ENABLED=n

# No PSRAM
CONFIG_SPIRAM=n

# Default partition table (no custom partitions.csv)
CONFIG_PARTITION_TABLE_SINGLE_APP=y

# Logging level
CONFIG_LOG_DEFAULT_LEVEL_INFO=y

# Larger main task stack for WiFi + ESP-NOW + I2C init
CONFIG_ESP_MAIN_TASK_STACK_SIZE=8192

# ADC oneshot driver (used by light sensor)
CONFIG_ADC_ONESHOT_CTRL_FUNC_IN_IRAM=n

# mDNS disabled (no WiFi STA mode in this project)
CONFIG_MDNS_ENABLED=n
```

## packages/usb-tools/facedancer-espdancer-fw/sdkconfig.defaults
```kconfig
# facedancer-espdancer-fw — ESP32-S3 configuration
# Production: TinyUSB owns the USB PHY (raw-DCD device emulator).
#             Control channel + logging over WiFi SoftAP.

CONFIG_IDF_TARGET="esp32s3"

# --- USB (raw DCD owns the PHY) ---
# USB-Serial-JTAG and USB-OTG share one PHY on ESP32-S3.
# Disable USB-Serial-JTAG so the vendored DCD port (components/raw_usb/
# tinyusb_port/, ADR-0006) can claim it exclusively. We do NOT pull the
# `espressif/esp_tinyusb` managed component (see main/idf_component.yml):
# its usbd.c strongly defines dcd_event_handler and its static
# process_control_request auto-handles USB standard requests; both
# incompatible with the Facedancer host-driven model.
CONFIG_USJ_ENABLE_USB_SERIAL_JTAG=n
CONFIG_ESP_CONSOLE_SECONDARY_NONE=y

# --- FreeRTOS ---
CONFIG_FREERTOS_HZ=1000
CONFIG_ESP_MAIN_TASK_STACK_SIZE=8192

# --- Flash & PSRAM (Waveshare ESP32-S3-Zero: 4MB flash, 2MB PSRAM) ---
CONFIG_ESPTOOLPY_FLASHSIZE_4MB=y
CONFIG_PARTITION_TABLE_CUSTOM=y
CONFIG_PARTITION_TABLE_CUSTOM_FILENAME="partitions.csv"
CONFIG_SPIRAM=y
CONFIG_SPIRAM_MODE_QUAD=y
CONFIG_SPIRAM_SPEED_80M=y

# --- WiFi (control channel + UDP log sink) ---
# ESP32-S3 supports concurrent WiFi + USB (no BT here, so coexistence is simple).
CONFIG_ESP_WIFI_ENABLED=y
# SoftAP-only operation; these AMPDU/NVS workarounds are S3-specific
# (espressif/esp-idf#13508, #8008) and were validated in xbox-switch-bridge.
CONFIG_ESP_WIFI_AMPDU_RX_ENABLED=n
CONFIG_ESP_WIFI_AMPDU_TX_ENABLED=n
CONFIG_ESP_WIFI_NVS_ENABLED=n
CONFIG_ESP_WIFI_ENABLE_WPA3_SAE=n
CONFIG_ESP_WIFI_ENABLE_SAE_PK=n
CONFIG_ESP_WIFI_11KV_SUPPORT=n
CONFIG_ESP_WIFI_STATIC_RX_BUFFER_NUM=6
CONFIG_ESP_WIFI_STATIC_TX_BUFFER_NUM=8

# --- Logging ---
CONFIG_LOG_DEFAULT_LEVEL_INFO=y

# --- Watchdog ---
CONFIG_ESP_TASK_WDT_TIMEOUT_S=10

# --- Power Management: disable for lowest USB latency ---
CONFIG_PM_ENABLE=n

# --- Compiler (GCC 13+ warnings in vendored TinyUSB if present) ---
CONFIG_COMPILER_DISABLE_GCC13_WARNINGS=y

# --- No Bluetooth (this is a USB device emulator, not a BLE bridge) ---
CONFIG_BT_ENABLED=n
```
