## robocar/esp32-cam-idf/sdkconfig.defaults
```kconfig
# ESP32-CAM Configuration

# Camera support (ESP-IDF 6.0 compatible)
# Camera module configuration handled by esp32-camera component

# WiFi Configuration (ESP-IDF 6.0 compatible)
CONFIG_ESP_WIFI_STATIC_RX_BUFFER_NUM=10
CONFIG_ESP_WIFI_DYNAMIC_RX_BUFFER_NUM=32
CONFIG_ESP_WIFI_TX_BUFFER_TYPE=1
CONFIG_ESP_WIFI_DYNAMIC_TX_BUFFER_NUM=32
CONFIG_ESP_WIFI_CSI_ENABLED=n

# HTTP Client
CONFIG_ESP_HTTP_CLIENT_ENABLE_HTTPS=y

# PSRAM configuration (ESP-IDF 6.0 compatible)
CONFIG_SPIRAM=y
CONFIG_SPIRAM_USE_MALLOC=y
CONFIG_SPIRAM_TYPE_AUTO=y
CONFIG_SPIRAM_SPEED_40M=y

# Memory optimization
CONFIG_SPIRAM_MALLOC_ALWAYSINTERNAL=16384
CONFIG_SPIRAM_MALLOC_RESERVE_INTERNAL=32768

# Logging
CONFIG_LOG_DEFAULT_LEVEL_INFO=y
CONFIG_LOG_DEFAULT_LEVEL=3

# FreeRTOS
CONFIG_FREERTOS_HZ=1000

# Main task stack size
CONFIG_ESP_MAIN_TASK_STACK_SIZE=8192

# Component configs
CONFIG_CAMERA_CORE0=y
CONFIG_CAMERA_DMA_BUFFER_SIZE_MAX=32768

# HTTP
CONFIG_ESP_HTTP_CLIENT_ENABLE_BASIC_AUTH=y

# Power Management - Disable brownout detector
CONFIG_ESP_BROWNOUT_DET=n

# WiFi Compatibility Settings for Aruba AP (ESP-IDF 6.0 compatible)
CONFIG_ESP_WIFI_AMPDU_TX_ENABLED=n
CONFIG_ESP_WIFI_AMPDU_RX_ENABLED=n
CONFIG_ESP_WIFI_AMSDU_TX_ENABLED=n
CONFIG_ESP_WIFI_NVS_ENABLED=y
CONFIG_ESP_WIFI_SOFTAP_BEACON_MAX_LEN=752
CONFIG_ESP_WIFI_MGMT_SBUF_NUM=32

# AI Backend Configuration
CONFIG_AI_BACKEND_OLLAMA=y
CONFIG_CONFIG_AI_BACKEND_OLLAMA=y

# Temporarily disable heap debugging features until TLSF submodule is updated
CONFIG_HEAP_TRACING=n
CONFIG_HEAP_CORRUPTION_DETECTION=n
CONFIG_HEAP_TASK_TRACKING=n

# Disable all advanced heap features that depend on TLSF functions
CONFIG_HEAP_TRACE_DEST_UART=n
CONFIG_HEAP_TRACE_DEST_HOST=n
CONFIG_HEAP_USE_HOOKS=n
CONFIG_HEAP_ABORT_WHEN_ALLOCATION_FAILS=n

# Use simpler heap allocator without TLSF-dependent features
CONFIG_HEAP_POISONING_DISABLED=y
```
